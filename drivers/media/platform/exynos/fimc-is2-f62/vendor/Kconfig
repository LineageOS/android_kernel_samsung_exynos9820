## drivers/media/platform/exynos/fimc-is2-f62/vendor/Kconfig
```kconfig
menu "Vendor Feature Setting"
	depends on EXYNOS_FIMC_IS

choice
	prompt "Use vender features"
	depends on EXYNOS_FIMC_IS
	default F62_VENDER_DEFAULT
	help
	  Use the vender specific features.

config F62_VENDER_DEFAULT
        bool "Default"
config F62_VENDER_MCD
        bool "MCD"
config F62_VENDER_PSV
        bool "PSV"
endchoice

source "drivers/media/platform/exynos/fimc-is2-f62/vendor/default/Kconfig"
source "drivers/media/platform/exynos/fimc-is2-f62/vendor/mcd/Kconfig"
endmenu
```

## drivers/media/platform/exynos/fimc-is2-f62/vendor/default/Kconfig
```kconfig
#
# Generic vendor feature config states
#

# Enable the vendor features
config SECURE_CAMERA_USE
	bool "Use secure camera"
	depends on F62_VENDER_DEFAULT
	default n
	---help---
	  Use secure camera.
```

## drivers/sensors/Kconfig
```kconfig
#
# grip sensors configuration
#

config SENSORS_A96T3X6
	depends on I2C
	tristate "A96T3X6 driver for grip"
	default n
	help
	  If you say yes here if you use A96T3X6 for grip.
	  This option enables grip sensors using
	  Above A96T3X6 device driver for grip.

config SENSORS_A96T3X6_SUB
	depends on I2C
	tristate "A96T3X6 driver for grip"
	default n
	help
	  Say Y here if you use A96T3X6 for grip.
	  This option enables grip sensors using
	  Above A96T3X6 device driver for grip.

config SENSOR_A96T3X6_LDO_SHARE
	depends on I2C
	tristate "SENSOR_A96T3X6_LDO_SHARE driver for grip"
	default n
	help
	  Say Y here if you use SENSOR_A96T3X6_LDO_SHARE for grip.
	  This option enables grip sensors using
	  Above SENSOR_A96T3X6_LDO_SHARE device driver for grip.

config SENSORS_A96T3X6_CRC_CHECK
	bool "check crc check instead of checksum compare"
	default n
	help
	  Say Y here if you use crc check instead of checksum compare

config SENSORS_A96T3X6_F62_FIRMWARE
	depends on I2C
	tristate "SENSORS_A96T3X6_F62 driver for grip firmware"
	default n
	help
	  Say Y here if you use F62 model grip firmware.

config SENSORS_ISG5320A
	depends on I2C
	tristate "ISG5320A grip"
	default n
	help
	  If you say yes here if you use ISG5320A for grip.
	  This option enables grip sensors using
	  IMAGIS ISG5320A device driver for grip.
```

## drivers/vibrator/common/Kconfig
```kconfig
config SEC_VIBRATOR
	tristate "sec vibrator"
	default n
	help
	  Say Y to enable Samsung's Motor support. This allows control of supported
	  Motors from both userspace interface by sysfs and provides common Motor
	  interfaces by registering.

	  If unsure, say N.

config SEC_VIB_NOTIFIER
	bool "use sec vibrator notifier"
	default n
	help
	  Enable notifier functions to get motor enable status
	  and timeout value by register notifiy

	  If you unsure, please select n
```

## drivers/vibrator/dc/Kconfig
```kconfig
config DC_VIBRATOR
	tristate "SEC DC Vibrator"
	default n
	help
	  This supports the motor which controlled by regulator or gpio.
	  The common interfaces are provided by common motor interfaces with samsung vibrator.

	  If unsure, say N.
```

## drivers/video/fbdev/exynos/panel/s6e3fa9/Kconfig
```kconfig
menuconfig EXYNOS_DECON_LCD_S6E3FA9
	tristate "S6E3FA9 DDI Panel Driver"
	depends on EXYNOS_DECON_LCD && EXYNOS_MIPI_DSIM
	help
		This enables S6E3FA9 DDI dependent panel drivers of
		common panel driver. say Y, if you have a panel based on
		the S6E3FA9 DDI.
```
